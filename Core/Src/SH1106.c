/**
 * @file    SH1106.c
 * @author  len (Updated by Meh)
 * @date    May 5, 2026
 * @brief   Implementation of the SH1106 OLED display driver.
 */

#include "SH1106.h"
#include "delay.h"

/**
 * @brief Standard 5x8 pixel ASCII Font.
 * @details Contains characters from ASCII 32 (Space) to 126 (~).
 * Each character is defined by 5 columns of 8-bit data.
 */
static const uint8_t font5x8[95][5] = {
    {0x00,0x00,0x00,0x00,0x00}, {0x00,0x00,0x5F,0x00,0x00}, {0x00,0x07,0x00,0x07,0x00}, {0x14,0x7F,0x14,0x7F,0x14},
    {0x24,0x2A,0x7F,0x2A,0x12}, {0x23,0x13,0x08,0x64,0x62}, {0x36,0x49,0x55,0x22,0x50}, {0x00,0x05,0x03,0x00,0x00},
    {0x00,0x1C,0x22,0x41,0x00}, {0x00,0x41,0x22,0x1C,0x00}, {0x14,0x08,0x3E,0x08,0x14}, {0x08,0x08,0x3E,0x08,0x08},
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    {0x00,0x00,0x7F,0x00,0x00}, {0x00,0x41,0x36,0x08,0x00}, {0x10,0x08,0x08,0x10,0x08}
};

/**
 * @brief   Helper function to send commands to the OLED controller.
 * @details The control byte 0x00 tells the OLED that the subsequent byte is an instruction.
 * @param   cmd The command byte to send.
 */
static void OLED_WriteCmd(uint8_t cmd) {
    I2C1_WriteReg(SH1106_ADDR, 0x00, cmd);
}

/**
 * @brief   Helper function to send display data (pixels) to the OLED GDDRAM.
 * @details The control byte 0x40 tells the OLED that the subsequent byte is graphic data.
 * @param   data The pixel data byte to write to the current cursor address.
 */
static void OLED_WriteData(uint8_t data) {
    I2C1_WriteReg(SH1106_ADDR, 0x40, data);
}

/**
 * @brief   Initializes the OLED display.
 */
void OLED_Init(void) {
    delay_ms(100); // Wait for power to stabilize before communicating

    OLED_WriteCmd(0xAE); // Display OFF
    OLED_WriteCmd(0xD5); // Set Display Clock Divide Ratio
    OLED_WriteCmd(0x80); // Default ratio
    OLED_WriteCmd(0xA8); // Set Multiplex Ratio
    OLED_WriteCmd(0x3F); // 64 lines (0x3F)
    OLED_WriteCmd(0xD3); // Set Display Offset
    OLED_WriteCmd(0x00); // 0 offset
    OLED_WriteCmd(0x40); // Set Display Start Line to 0
    OLED_WriteCmd(0x8D); // Charge Pump Setting
    OLED_WriteCmd(0x14); // Enable Charge Pump (Required to turn on the panel)
    OLED_WriteCmd(0xA1); // Segment Re-map (A0 or A1 flips X axis)
    OLED_WriteCmd(0xC8); // COM Output Scan Direction (C0 or C8 flips Y axis)
    OLED_WriteCmd(0xDA); // COM Pins Hardware Configuration
    OLED_WriteCmd(0x12);
    OLED_WriteCmd(0x81); // Contrast Control
    OLED_WriteCmd(0xCF); // Contrast value (0-255)
    OLED_WriteCmd(0xD9); // Pre-charge Period
    OLED_WriteCmd(0xF1);
    OLED_WriteCmd(0xDB); // VCOMH Deselect Level
    OLED_WriteCmd(0x40);
    OLED_WriteCmd(0xA4); // Entire Display ON resume
    OLED_WriteCmd(0xA6); // Normal Display (A7 = Inverted)

    /* Clear the memory before turning the display on to avoid random static */
    OLED_Clear();

    OLED_WriteCmd(0xAF); // Display ON
}

/**
 * @brief   Sets the cursor position for the next text or drawing operation.
 */
void OLED_SetCursor(uint8_t page, uint8_t col) {
    /* * SH1106 Specific Quirk:
     * The SH1106 RAM supports 132 columns, but standard OLED panels are only
     * 128 pixels wide. The panel is physically centered on the RAM, meaning
     * columns 0 and 1, and columns 130 and 131 are invisible.
     * We must add a +2 offset to correctly align X=0 with the edge of the screen.
     */
    col += 2;

    /* Set Page (Row 0-7) */
    OLED_WriteCmd(0xB0 | (page & 0x07));

    /* Set Lower Column Nibble (0x00 to 0x0F) */
    OLED_WriteCmd(0x00 | (col & 0x0F));

    /* Set Higher Column Nibble (0x10 to 0x17) */
    OLED_WriteCmd(0x10 | ((col >> 4) & 0x0F));
}

/**
 * @brief   Clears the entire screen.
 */
void OLED_Clear(void) {
    /* Iterate through all 8 horizontal pages (rows) */
    for (uint8_t page = 0; page < 8; page++) {
        OLED_SetCursor(page, 0);

        /* Iterate through all 128 visible columns, writing 0x00 to blank them */
        for (uint8_t col = 0; col < 128; col++) {
            OLED_WriteData(0x00);
        }
    }
}

/**
 * @brief   Prints a single ASCII character at the current cursor position.
 */
void OLED_PrintChar(char c) {
    /* Check if the character is out of bounds of our ASCII font array */
    if (c < 32 || c > 126) return;

    /* Draw the 5 vertical columns of the character */
    for (uint8_t i = 0; i < 5; i++) {
        OLED_WriteData(font5x8[c - 32][i]);
    }

    /* Add 1 column of blank space (padding) between characters */
    OLED_WriteData(0x00);
}

/**
 * @brief   Prints a null-terminated string starting at the current cursor position.
 */
void OLED_PrintString(char* str) {
    /* Iterate over the string until the null terminator (\0) is reached */
    while (*str) {
        OLED_PrintChar(*str++);
    }
}
